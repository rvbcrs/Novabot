/*
 * Display — ST7789V 240x320 color LCD via SPI2
 *
 * Full driver implementation based on OEM firmware reverse engineering:
 *   - LCD init function at 0x08009D78 (complete register init sequence)
 *   - lcd_write_cmd at 0x0800A010 (DC=0, SPI2 transmit)
 *   - lcd_write_data at 0x08009FD4 (DC=1, SPI2 transmit)
 *   - Rotation function at 0x0800A074 (MADCTL orientations)
 *
 * Features:
 *   - Hardware SPI2 at 10.5 MHz
 *   - Direct pixel writes (no framebuffer — saves 150KB RAM)
 *   - Built-in 8x16 ASCII font
 *   - "OpenNova" boot animation with teal/white color scheme
 *   - Battery icon, status text, error display
 */

#include "display.h"
#include "config.h"
#include "stm32f4xx_hal.h"
#include <string.h>
#include <stdio.h>

/* ========================================================================
 * SPI2 handle and GPIO
 * ======================================================================== */

static SPI_HandleTypeDef hspi2;

/* Inline helpers for DC and CS pin control */
static inline void dc_cmd(void)  { HAL_GPIO_WritePin(DISPLAY_DC_PORT,  DISPLAY_DC_PIN,  GPIO_PIN_RESET); }
static inline void dc_data(void) { HAL_GPIO_WritePin(DISPLAY_DC_PORT,  DISPLAY_DC_PIN,  GPIO_PIN_SET);   }
static inline void cs_low(void)  { HAL_GPIO_WritePin(DISPLAY_SPI_PORT, DISPLAY_CS_PIN,  GPIO_PIN_RESET); }
static inline void cs_high(void) { HAL_GPIO_WritePin(DISPLAY_SPI_PORT, DISPLAY_CS_PIN,  GPIO_PIN_SET);   }
static inline void rst_low(void) { HAL_GPIO_WritePin(DISPLAY_RST_PORT, DISPLAY_RST_PIN, GPIO_PIN_RESET); }
static inline void rst_high(void){ HAL_GPIO_WritePin(DISPLAY_RST_PORT, DISPLAY_RST_PIN, GPIO_PIN_SET);   }

/* ========================================================================
 * 8x16 ASCII font (characters 0x20 - 0x7E, 95 chars)
 *
 * Each character is 8 pixels wide, 16 pixels tall = 16 bytes per char.
 * Standard VGA-style bitmap font, suitable for status text.
 * ======================================================================== */

static const uint8_t font_8x16[] = {
    /* 0x20 ' ' */ 0x00,0x00,0x00,0x00,0x00,0x00,0x00,0x00,0x00,0x00,0x00,0x00,0x00,0x00,0x00,0x00,
    /* 0x21 '!' */ 0x00,0x00,0x18,0x3C,0x3C,0x3C,0x18,0x18,0x18,0x00,0x18,0x18,0x00,0x00,0x00,0x00,
    /* 0x22 '"' */ 0x00,0x63,0x63,0x63,0x22,0x00,0x00,0x00,0x00,0x00,0x00,0x00,0x00,0x00,0x00,0x00,
    /* 0x23 '#' */ 0x00,0x00,0x00,0x36,0x36,0x7F,0x36,0x36,0x7F,0x36,0x36,0x00,0x00,0x00,0x00,0x00,
    /* 0x24 '$' */ 0x0C,0x0C,0x3E,0x63,0x61,0x60,0x3E,0x03,0x03,0x43,0x63,0x3E,0x0C,0x0C,0x00,0x00,
    /* 0x25 '%' */ 0x00,0x00,0x00,0x00,0x61,0x63,0x06,0x0C,0x18,0x30,0x63,0x43,0x00,0x00,0x00,0x00,
    /* 0x26 '&' */ 0x00,0x00,0x1C,0x36,0x36,0x1C,0x6E,0x3B,0x33,0x33,0x33,0x6E,0x00,0x00,0x00,0x00,
    /* 0x27 ''' */ 0x00,0x0C,0x0C,0x0C,0x18,0x00,0x00,0x00,0x00,0x00,0x00,0x00,0x00,0x00,0x00,0x00,
    /* 0x28 '(' */ 0x00,0x00,0x0C,0x18,0x30,0x30,0x30,0x30,0x30,0x30,0x18,0x0C,0x00,0x00,0x00,0x00,
    /* 0x29 ')' */ 0x00,0x00,0x30,0x18,0x0C,0x0C,0x0C,0x0C,0x0C,0x0C,0x18,0x30,0x00,0x00,0x00,0x00,
    /* 0x2A '*' */ 0x00,0x00,0x00,0x00,0x00,0x66,0x3C,0xFF,0x3C,0x66,0x00,0x00,0x00,0x00,0x00,0x00,
    /* 0x2B '+' */ 0x00,0x00,0x00,0x00,0x00,0x18,0x18,0x7E,0x18,0x18,0x00,0x00,0x00,0x00,0x00,0x00,
    /* 0x2C ',' */ 0x00,0x00,0x00,0x00,0x00,0x00,0x00,0x00,0x00,0x00,0x18,0x18,0x18,0x30,0x00,0x00,
    /* 0x2D '-' */ 0x00,0x00,0x00,0x00,0x00,0x00,0x00,0x7E,0x00,0x00,0x00,0x00,0x00,0x00,0x00,0x00,
    /* 0x2E '.' */ 0x00,0x00,0x00,0x00,0x00,0x00,0x00,0x00,0x00,0x00,0x18,0x18,0x00,0x00,0x00,0x00,
    /* 0x2F '/' */ 0x00,0x00,0x00,0x00,0x01,0x03,0x06,0x0C,0x18,0x30,0x60,0x40,0x00,0x00,0x00,0x00,
    /* 0x30 '0' */ 0x00,0x00,0x3E,0x63,0x63,0x67,0x6F,0x7B,0x73,0x63,0x63,0x3E,0x00,0x00,0x00,0x00,
    /* 0x31 '1' */ 0x00,0x00,0x0C,0x1C,0x3C,0x0C,0x0C,0x0C,0x0C,0x0C,0x0C,0x3F,0x00,0x00,0x00,0x00,
    /* 0x32 '2' */ 0x00,0x00,0x3E,0x63,0x03,0x06,0x0C,0x18,0x30,0x60,0x63,0x7F,0x00,0x00,0x00,0x00,
    /* 0x33 '3' */ 0x00,0x00,0x3E,0x63,0x03,0x03,0x1E,0x03,0x03,0x03,0x63,0x3E,0x00,0x00,0x00,0x00,
    /* 0x34 '4' */ 0x00,0x00,0x06,0x0E,0x1E,0x36,0x66,0x7F,0x06,0x06,0x06,0x0F,0x00,0x00,0x00,0x00,
    /* 0x35 '5' */ 0x00,0x00,0x7F,0x60,0x60,0x60,0x7E,0x03,0x03,0x03,0x63,0x3E,0x00,0x00,0x00,0x00,
    /* 0x36 '6' */ 0x00,0x00,0x1C,0x30,0x60,0x60,0x7E,0x63,0x63,0x63,0x63,0x3E,0x00,0x00,0x00,0x00,
    /* 0x37 '7' */ 0x00,0x00,0x7F,0x63,0x03,0x03,0x06,0x0C,0x18,0x18,0x18,0x18,0x00,0x00,0x00,0x00,
    /* 0x38 '8' */ 0x00,0x00,0x3E,0x63,0x63,0x63,0x3E,0x63,0x63,0x63,0x63,0x3E,0x00,0x00,0x00,0x00,
    /* 0x39 '9' */ 0x00,0x00,0x3E,0x63,0x63,0x63,0x63,0x3F,0x03,0x03,0x06,0x3C,0x00,0x00,0x00,0x00,
    /* 0x3A ':' */ 0x00,0x00,0x00,0x00,0x18,0x18,0x00,0x00,0x00,0x18,0x18,0x00,0x00,0x00,0x00,0x00,
    /* 0x3B ';' */ 0x00,0x00,0x00,0x00,0x18,0x18,0x00,0x00,0x00,0x18,0x18,0x30,0x00,0x00,0x00,0x00,
    /* 0x3C '<' */ 0x00,0x00,0x00,0x06,0x0C,0x18,0x30,0x60,0x30,0x18,0x0C,0x06,0x00,0x00,0x00,0x00,
    /* 0x3D '=' */ 0x00,0x00,0x00,0x00,0x00,0x7E,0x00,0x00,0x7E,0x00,0x00,0x00,0x00,0x00,0x00,0x00,
    /* 0x3E '>' */ 0x00,0x00,0x00,0x60,0x30,0x18,0x0C,0x06,0x0C,0x18,0x30,0x60,0x00,0x00,0x00,0x00,
    /* 0x3F '?' */ 0x00,0x00,0x3E,0x63,0x63,0x06,0x0C,0x0C,0x0C,0x00,0x0C,0x0C,0x00,0x00,0x00,0x00,
    /* 0x40 '@' */ 0x00,0x00,0x00,0x3E,0x63,0x63,0x6F,0x6F,0x6F,0x6E,0x60,0x3E,0x00,0x00,0x00,0x00,
    /* 0x41 'A' */ 0x00,0x00,0x08,0x1C,0x36,0x63,0x63,0x7F,0x63,0x63,0x63,0x63,0x00,0x00,0x00,0x00,
    /* 0x42 'B' */ 0x00,0x00,0x7E,0x33,0x33,0x33,0x3E,0x33,0x33,0x33,0x33,0x7E,0x00,0x00,0x00,0x00,
    /* 0x43 'C' */ 0x00,0x00,0x1E,0x33,0x61,0x60,0x60,0x60,0x60,0x61,0x33,0x1E,0x00,0x00,0x00,0x00,
    /* 0x44 'D' */ 0x00,0x00,0x7C,0x36,0x33,0x33,0x33,0x33,0x33,0x33,0x36,0x7C,0x00,0x00,0x00,0x00,
    /* 0x45 'E' */ 0x00,0x00,0x7F,0x33,0x31,0x34,0x3C,0x34,0x30,0x31,0x33,0x7F,0x00,0x00,0x00,0x00,
    /* 0x46 'F' */ 0x00,0x00,0x7F,0x33,0x31,0x34,0x3C,0x34,0x30,0x30,0x30,0x78,0x00,0x00,0x00,0x00,
    /* 0x47 'G' */ 0x00,0x00,0x1E,0x33,0x61,0x60,0x60,0x6F,0x63,0x63,0x37,0x1D,0x00,0x00,0x00,0x00,
    /* 0x48 'H' */ 0x00,0x00,0x63,0x63,0x63,0x63,0x7F,0x63,0x63,0x63,0x63,0x63,0x00,0x00,0x00,0x00,
    /* 0x49 'I' */ 0x00,0x00,0x3C,0x18,0x18,0x18,0x18,0x18,0x18,0x18,0x18,0x3C,0x00,0x00,0x00,0x00,
    /* 0x4A 'J' */ 0x00,0x00,0x1E,0x0C,0x0C,0x0C,0x0C,0x0C,0x0C,0x6C,0x6C,0x38,0x00,0x00,0x00,0x00,
    /* 0x4B 'K' */ 0x00,0x00,0x73,0x33,0x36,0x36,0x3C,0x36,0x36,0x33,0x33,0x73,0x00,0x00,0x00,0x00,
    /* 0x4C 'L' */ 0x00,0x00,0x78,0x30,0x30,0x30,0x30,0x30,0x30,0x31,0x33,0x7F,0x00,0x00,0x00,0x00,
    /* 0x4D 'M' */ 0x00,0x00,0xC3,0xE7,0xFF,0xFF,0xDB,0xC3,0xC3,0xC3,0xC3,0xC3,0x00,0x00,0x00,0x00,
    /* 0x4E 'N' */ 0x00,0x00,0x63,0x73,0x7B,0x7F,0x6F,0x67,0x63,0x63,0x63,0x63,0x00,0x00,0x00,0x00,
    /* 0x4F 'O' */ 0x00,0x00,0x3E,0x63,0x63,0x63,0x63,0x63,0x63,0x63,0x63,0x3E,0x00,0x00,0x00,0x00,
    /* 0x50 'P' */ 0x00,0x00,0x7E,0x33,0x33,0x33,0x3E,0x30,0x30,0x30,0x30,0x78,0x00,0x00,0x00,0x00,
    /* 0x51 'Q' */ 0x00,0x00,0x3E,0x63,0x63,0x63,0x63,0x63,0x63,0x6B,0x6F,0x3E,0x06,0x07,0x00,0x00,
    /* 0x52 'R' */ 0x00,0x00,0x7E,0x33,0x33,0x33,0x3E,0x36,0x36,0x33,0x33,0x73,0x00,0x00,0x00,0x00,
    /* 0x53 'S' */ 0x00,0x00,0x3E,0x63,0x63,0x30,0x1C,0x06,0x03,0x63,0x63,0x3E,0x00,0x00,0x00,0x00,
    /* 0x54 'T' */ 0x00,0x00,0xFF,0xDB,0x99,0x18,0x18,0x18,0x18,0x18,0x18,0x3C,0x00,0x00,0x00,0x00,
    /* 0x55 'U' */ 0x00,0x00,0x63,0x63,0x63,0x63,0x63,0x63,0x63,0x63,0x63,0x3E,0x00,0x00,0x00,0x00,
    /* 0x56 'V' */ 0x00,0x00,0x63,0x63,0x63,0x63,0x63,0x63,0x63,0x36,0x1C,0x08,0x00,0x00,0x00,0x00,
    /* 0x57 'W' */ 0x00,0x00,0xC3,0xC3,0xC3,0xC3,0xC3,0xDB,0xDB,0xFF,0x66,0x66,0x00,0x00,0x00,0x00,
    /* 0x58 'X' */ 0x00,0x00,0xC3,0xC3,0x66,0x3C,0x18,0x18,0x3C,0x66,0xC3,0xC3,0x00,0x00,0x00,0x00,
    /* 0x59 'Y' */ 0x00,0x00,0xC3,0xC3,0xC3,0x66,0x3C,0x18,0x18,0x18,0x18,0x3C,0x00,0x00,0x00,0x00,
    /* 0x5A 'Z' */ 0x00,0x00,0x7F,0x63,0x46,0x0C,0x18,0x30,0x60,0x61,0x63,0x7F,0x00,0x00,0x00,0x00,
    /* 0x5B '[' */ 0x00,0x00,0x3C,0x30,0x30,0x30,0x30,0x30,0x30,0x30,0x30,0x3C,0x00,0x00,0x00,0x00,
    /* 0x5C '\' */ 0x00,0x00,0x00,0x40,0x60,0x30,0x18,0x0C,0x06,0x03,0x01,0x00,0x00,0x00,0x00,0x00,
    /* 0x5D ']' */ 0x00,0x00,0x3C,0x0C,0x0C,0x0C,0x0C,0x0C,0x0C,0x0C,0x0C,0x3C,0x00,0x00,0x00,0x00,
    /* 0x5E '^' */ 0x08,0x1C,0x36,0x63,0x00,0x00,0x00,0x00,0x00,0x00,0x00,0x00,0x00,0x00,0x00,0x00,
    /* 0x5F '_' */ 0x00,0x00,0x00,0x00,0x00,0x00,0x00,0x00,0x00,0x00,0x00,0x00,0xFF,0x00,0x00,0x00,
    /* 0x60 '`' */ 0x00,0x30,0x18,0x0C,0x00,0x00,0x00,0x00,0x00,0x00,0x00,0x00,0x00,0x00,0x00,0x00,
    /* 0x61 'a' */ 0x00,0x00,0x00,0x00,0x00,0x3C,0x46,0x06,0x3E,0x66,0x66,0x3B,0x00,0x00,0x00,0x00,
    /* 0x62 'b' */ 0x00,0x00,0x70,0x30,0x30,0x3C,0x36,0x33,0x33,0x33,0x33,0x3E,0x00,0x00,0x00,0x00,
    /* 0x63 'c' */ 0x00,0x00,0x00,0x00,0x00,0x3E,0x63,0x60,0x60,0x60,0x63,0x3E,0x00,0x00,0x00,0x00,
    /* 0x64 'd' */ 0x00,0x00,0x0E,0x06,0x06,0x1E,0x36,0x66,0x66,0x66,0x66,0x3B,0x00,0x00,0x00,0x00,
    /* 0x65 'e' */ 0x00,0x00,0x00,0x00,0x00,0x3E,0x63,0x7F,0x60,0x60,0x63,0x3E,0x00,0x00,0x00,0x00,
    /* 0x66 'f' */ 0x00,0x00,0x1C,0x36,0x32,0x30,0x7C,0x30,0x30,0x30,0x30,0x78,0x00,0x00,0x00,0x00,
    /* 0x67 'g' */ 0x00,0x00,0x00,0x00,0x00,0x3B,0x66,0x66,0x66,0x66,0x3E,0x06,0x66,0x3C,0x00,0x00,
    /* 0x68 'h' */ 0x00,0x00,0x70,0x30,0x30,0x36,0x3B,0x33,0x33,0x33,0x33,0x73,0x00,0x00,0x00,0x00,
    /* 0x69 'i' */ 0x00,0x00,0x0C,0x0C,0x00,0x1C,0x0C,0x0C,0x0C,0x0C,0x0C,0x1E,0x00,0x00,0x00,0x00,
    /* 0x6A 'j' */ 0x00,0x00,0x06,0x06,0x00,0x0E,0x06,0x06,0x06,0x06,0x06,0x06,0x66,0x3C,0x00,0x00,
    /* 0x6B 'k' */ 0x00,0x00,0x70,0x30,0x30,0x33,0x36,0x3C,0x3C,0x36,0x33,0x73,0x00,0x00,0x00,0x00,
    /* 0x6C 'l' */ 0x00,0x00,0x1C,0x0C,0x0C,0x0C,0x0C,0x0C,0x0C,0x0C,0x0C,0x1E,0x00,0x00,0x00,0x00,
    /* 0x6D 'm' */ 0x00,0x00,0x00,0x00,0x00,0x6E,0x7F,0x6B,0x6B,0x6B,0x6B,0x6B,0x00,0x00,0x00,0x00,
    /* 0x6E 'n' */ 0x00,0x00,0x00,0x00,0x00,0x6E,0x33,0x33,0x33,0x33,0x33,0x33,0x00,0x00,0x00,0x00,
    /* 0x6F 'o' */ 0x00,0x00,0x00,0x00,0x00,0x3E,0x63,0x63,0x63,0x63,0x63,0x3E,0x00,0x00,0x00,0x00,
    /* 0x70 'p' */ 0x00,0x00,0x00,0x00,0x00,0x6E,0x33,0x33,0x33,0x33,0x3E,0x30,0x30,0x78,0x00,0x00,
    /* 0x71 'q' */ 0x00,0x00,0x00,0x00,0x00,0x3B,0x66,0x66,0x66,0x66,0x3E,0x06,0x06,0x0F,0x00,0x00,
    /* 0x72 'r' */ 0x00,0x00,0x00,0x00,0x00,0x6E,0x3B,0x33,0x30,0x30,0x30,0x78,0x00,0x00,0x00,0x00,
    /* 0x73 's' */ 0x00,0x00,0x00,0x00,0x00,0x3E,0x63,0x38,0x0E,0x03,0x63,0x3E,0x00,0x00,0x00,0x00,
    /* 0x74 't' */ 0x00,0x00,0x08,0x18,0x18,0x7E,0x18,0x18,0x18,0x18,0x1B,0x0E,0x00,0x00,0x00,0x00,
    /* 0x75 'u' */ 0x00,0x00,0x00,0x00,0x00,0x66,0x66,0x66,0x66,0x66,0x66,0x3B,0x00,0x00,0x00,0x00,
    /* 0x76 'v' */ 0x00,0x00,0x00,0x00,0x00,0x63,0x63,0x63,0x63,0x36,0x1C,0x08,0x00,0x00,0x00,0x00,
    /* 0x77 'w' */ 0x00,0x00,0x00,0x00,0x00,0xC3,0xC3,0xC3,0xDB,0xDB,0xFF,0x66,0x00,0x00,0x00,0x00,
    /* 0x78 'x' */ 0x00,0x00,0x00,0x00,0x00,0x63,0x36,0x1C,0x1C,0x36,0x63,0x63,0x00,0x00,0x00,0x00,
    /* 0x79 'y' */ 0x00,0x00,0x00,0x00,0x00,0x63,0x63,0x63,0x63,0x63,0x3F,0x03,0x06,0x3C,0x00,0x00,
    /* 0x7A 'z' */ 0x00,0x00,0x00,0x00,0x00,0x7F,0x66,0x0C,0x18,0x30,0x63,0x7F,0x00,0x00,0x00,0x00,
    /* 0x7B '{' */ 0x00,0x00,0x0E,0x18,0x18,0x18,0x70,0x18,0x18,0x18,0x18,0x0E,0x00,0x00,0x00,0x00,
    /* 0x7C '|' */ 0x00,0x00,0x18,0x18,0x18,0x18,0x00,0x18,0x18,0x18,0x18,0x18,0x00,0x00,0x00,0x00,
    /* 0x7D '}' */ 0x00,0x00,0x70,0x18,0x18,0x18,0x0E,0x18,0x18,0x18,0x18,0x70,0x00,0x00,0x00,0x00,
    /* 0x7E '~' */ 0x00,0x00,0x3B,0x6E,0x00,0x00,0x00,0x00,0x00,0x00,0x00,0x00,0x00,0x00,0x00,0x00,
};

#define FONT_W      8U
#define FONT_H      16U
#define FONT_FIRST  0x20U
#define FONT_LAST   0x7EU

/* ========================================================================
 * Low-level SPI / ST7789V helpers
 * ======================================================================== */

void display_write_cmd(uint8_t cmd)
{
    cs_low();
    dc_cmd();
    HAL_SPI_Transmit(&hspi2, &cmd, 1, 10);
    cs_high();
}

void display_write_data8(uint8_t data)
{
    cs_low();
    dc_data();
    HAL_SPI_Transmit(&hspi2, &data, 1, 10);
    cs_high();
}

void display_write_data(const uint8_t *data, uint16_t len)
{
    cs_low();
    dc_data();
    HAL_SPI_Transmit(&hspi2, (uint8_t *)data, len, 100);
    cs_high();
}

/* Write 16-bit value (big-endian, as ST7789V expects) */
static void write_data16(uint16_t val)
{
    uint8_t buf[2] = { (uint8_t)(val >> 8), (uint8_t)(val & 0xFF) };
    cs_low();
    dc_data();
    HAL_SPI_Transmit(&hspi2, buf, 2, 10);
    cs_high();
}

void display_set_window(uint16_t x0, uint16_t y0, uint16_t x1, uint16_t y1)
{
    display_write_cmd(ST7789_CASET);
    write_data16(x0);
    write_data16(x1);

    display_write_cmd(ST7789_RASET);
    write_data16(y0);
    write_data16(y1);

    display_write_cmd(ST7789_RAMWR);
}

/* ========================================================================
 * Initialization — ST7789V register sequence from OEM binary
 * ======================================================================== */

void display_init(void)
{
    /* --- GPIO configuration --- */

    /* SPI2 pins: PB13=SCK, PB15=MOSI (alternate function) */
    GPIO_InitTypeDef gpio = {0};
    gpio.Pin = DISPLAY_SCK_PIN | DISPLAY_MOSI_PIN;
    gpio.Mode = GPIO_MODE_AF_PP;
    gpio.Pull = GPIO_NOPULL;
    gpio.Speed = GPIO_SPEED_FREQ_VERY_HIGH;
    gpio.Alternate = GPIO_AF5_SPI2;
    HAL_GPIO_Init(DISPLAY_SPI_PORT, &gpio);

    /* CS pin: PB12 (software NSS, active low) */
    gpio.Pin = DISPLAY_CS_PIN;
    gpio.Mode = GPIO_MODE_OUTPUT_PP;
    gpio.Pull = GPIO_PULLUP;
    gpio.Speed = GPIO_SPEED_FREQ_HIGH;
    gpio.Alternate = 0;
    HAL_GPIO_Init(DISPLAY_SPI_PORT, &gpio);
    cs_high();

    /* DC pin */
    gpio.Pin = DISPLAY_DC_PIN;
    HAL_GPIO_Init(DISPLAY_DC_PORT, &gpio);

    /* RST pin */
    gpio.Pin = DISPLAY_RST_PIN;
    HAL_GPIO_Init(DISPLAY_RST_PORT, &gpio);

    /* --- SPI2 configuration --- */

    __HAL_RCC_SPI2_CLK_ENABLE();

    hspi2.Instance = SPI2;
    hspi2.Init.Mode = SPI_MODE_MASTER;
    hspi2.Init.Direction = SPI_DIRECTION_2LINES;
    hspi2.Init.DataSize = SPI_DATASIZE_8BIT;
    hspi2.Init.CLKPolarity = SPI_POLARITY_LOW;
    hspi2.Init.CLKPhase = SPI_PHASE_1EDGE;
    hspi2.Init.NSS = SPI_NSS_SOFT;
    hspi2.Init.BaudRatePrescaler = SPI_BAUDRATEPRESCALER_4; /* 42/4 = 10.5 MHz */
    hspi2.Init.FirstBit = SPI_FIRSTBIT_MSB;
    hspi2.Init.TIMode = SPI_TIMODE_DISABLE;
    hspi2.Init.CRCCalculation = SPI_CRCCALCULATION_DISABLE;

    HAL_SPI_Init(&hspi2);

    /* --- Hardware reset --- */

    rst_high();
    HAL_Delay(10);
    rst_low();
    HAL_Delay(10);
    rst_high();
    HAL_Delay(120);

    /* --- ST7789V init sequence (from OEM binary at 0x08009D78) --- */

    display_write_cmd(ST7789_SWRESET);
    HAL_Delay(150);

    display_write_cmd(ST7789_SLPOUT);
    HAL_Delay(120);

    /* Color mode: 16-bit RGB565 */
    display_write_cmd(ST7789_COLMOD);
    display_write_data8(0x05);  /* 16-bit/pixel */

    /* Porch control (from OEM: 0x0C 0x0C 0x00 0x33 0x33) */
    display_write_cmd(ST7789_PORCTRL);
    {
        uint8_t d[] = {0x0C, 0x0C, 0x00, 0x33, 0x33};
        display_write_data(d, sizeof(d));
    }

    /* Gate control */
    display_write_cmd(ST7789_GCTRL);
    display_write_data8(0x35);

    /* VCOM setting */
    display_write_cmd(ST7789_VCOMS);
    display_write_data8(0x35);

    /* LCM control */
    display_write_cmd(ST7789_LCMCTRL);
    display_write_data8(0x2C);

    /* VDV and VRH command enable */
    display_write_cmd(ST7789_VDVVRHEN);
    display_write_data8(0x01);

    /* VRH set */
    display_write_cmd(ST7789_VRHS);
    display_write_data8(0x13);

    /* VDV set */
    display_write_cmd(ST7789_VDVSET);
    display_write_data8(0x20);

    /* Frame rate control: 60 Hz */
    display_write_cmd(ST7789_FRCTR2);
    display_write_data8(0x0F);

    /* Power control 1 */
    display_write_cmd(ST7789_PWCTRL1);
    {
        uint8_t d[] = {0xA4, 0xA1};
        display_write_data(d, sizeof(d));
    }

    /* Positive gamma correction */
    display_write_cmd(ST7789_PVGAMCTRL);
    {
        uint8_t d[] = {0xD0, 0x08, 0x0E, 0x09, 0x09, 0x05, 0x31, 0x33,
                       0x48, 0x17, 0x14, 0x15, 0x31, 0x34};
        display_write_data(d, sizeof(d));
    }

    /* Negative gamma correction */
    display_write_cmd(ST7789_NVGAMCTRL);
    {
        uint8_t d[] = {0xD0, 0x08, 0x0E, 0x09, 0x09, 0x15, 0x31, 0x33,
                       0x48, 0x17, 0x14, 0x15, 0x31, 0x34};
        display_write_data(d, sizeof(d));
    }

    /* Set orientation (landscape: MADCTL = 0x60) */
#if DISPLAY_ORIENTATION == 1
    display_write_cmd(ST7789_MADCTL);
    display_write_data8(0x60);  /* MV=1, MX=1 → landscape 320x240 */
#else
    display_write_cmd(ST7789_MADCTL);
    display_write_data8(0x00);  /* Portrait 240x320 */
#endif

    /* Inversion on (ST7789 panels typically need this) */
    display_write_cmd(ST7789_INVON);

    /* Normal display mode */
    display_write_cmd(ST7789_NORON);
    HAL_Delay(10);

    /* Display on */
    display_write_cmd(ST7789_DISPON);
    HAL_Delay(10);

    /* Clear to black */
    display_fill(COLOR_BLACK);
}

/* ========================================================================
 * Drawing primitives
 * ======================================================================== */

void display_fill(uint16_t color)
{
    display_fill_rect(0, 0, DISP_W, DISP_H, color);
}

void display_clear(void)
{
    display_fill(COLOR_BLACK);
}

void display_draw_pixel(uint16_t x, uint16_t y, uint16_t color)
{
    if (x >= DISP_W || y >= DISP_H) return;
    display_set_window(x, y, x, y);
    write_data16(color);
}

void display_fill_rect(uint16_t x, uint16_t y, uint16_t w, uint16_t h, uint16_t color)
{
    if (x >= DISP_W || y >= DISP_H) return;
    if (x + w > DISP_W) w = DISP_W - x;
    if (y + h > DISP_H) h = DISP_H - y;

    display_set_window(x, y, x + w - 1, y + h - 1);

    /* Prepare color bytes (big-endian) */
    uint8_t hi = (uint8_t)(color >> 8);
    uint8_t lo = (uint8_t)(color & 0xFF);

    /* Send in chunks to avoid huge stack buffers */
    uint8_t line_buf[64];
    for (uint16_t i = 0; i < 32; i++)
    {
        line_buf[i * 2]     = hi;
        line_buf[i * 2 + 1] = lo;
    }

    uint32_t total = (uint32_t)w * h;
    cs_low();
    dc_data();
    while (total > 0)
    {
        uint16_t chunk = (total > 32) ? 32 : (uint16_t)total;
        HAL_SPI_Transmit(&hspi2, line_buf, chunk * 2, 100);
        total -= chunk;
    }
    cs_high();
}

void display_draw_hline(uint16_t x, uint16_t y, uint16_t w, uint16_t color)
{
    display_fill_rect(x, y, w, 1, color);
}

void display_draw_vline(uint16_t x, uint16_t y, uint16_t h, uint16_t color)
{
    display_fill_rect(x, y, 1, h, color);
}

void display_draw_rect(uint16_t x, uint16_t y, uint16_t w, uint16_t h, uint16_t color)
{
    display_draw_hline(x, y, w, color);
    display_draw_hline(x, y + h - 1, w, color);
    display_draw_vline(x, y, h, color);
    display_draw_vline(x + w - 1, y, h, color);
}

void display_fill_round_rect(uint16_t x, uint16_t y, uint16_t w, uint16_t h,
                              uint16_t r, uint16_t color)
{
    /* Fill center rectangle */
    display_fill_rect(x + r, y, w - 2 * r, h, color);

    /* Fill side rectangles */
    display_fill_rect(x, y + r, r, h - 2 * r, color);
    display_fill_rect(x + w - r, y + r, r, h - 2 * r, color);

    /* Draw rounded corners using Bresenham circle */
    int16_t cx, cy, d;
    cx = 0;
    cy = (int16_t)r;
    d = 3 - 2 * (int16_t)r;

    while (cx <= cy)
    {
        /* Top-left corner */
        display_draw_hline(x + r - cy, y + r - cx, cy, color);
        display_draw_hline(x + r - cx, y + r - cy, cx, color);
        /* Top-right corner */
        display_draw_hline(x + w - r, y + r - cx, cy, color);
        display_draw_hline(x + w - r, y + r - cy, cx, color);
        /* Bottom-left corner */
        display_draw_hline(x + r - cy, y + h - r + cx - 1, cy, color);
        display_draw_hline(x + r - cx, y + h - r + cy - 1, cx, color);
        /* Bottom-right corner */
        display_draw_hline(x + w - r, y + h - r + cx - 1, cy, color);
        display_draw_hline(x + w - r, y + h - r + cy - 1, cx, color);

        if (d < 0)
            d += 4 * cx + 6;
        else
        {
            d += 4 * (cx - cy) + 10;
            cy--;
        }
        cx++;
    }
}

/* ========================================================================
 * Text rendering
 * ======================================================================== */

void display_draw_char(uint16_t x, uint16_t y, char c, uint16_t fg, uint16_t bg)
{
    if (c < FONT_FIRST || c > FONT_LAST) c = ' ';
    if (x + FONT_W > DISP_W || y + FONT_H > DISP_H) return;

    const uint8_t *glyph = &font_8x16[(c - FONT_FIRST) * FONT_H];

    display_set_window(x, y, x + FONT_W - 1, y + FONT_H - 1);

    uint8_t buf[FONT_W * FONT_H * 2];
    uint16_t idx = 0;

    for (uint8_t row = 0; row < FONT_H; row++)
    {
        uint8_t bits = glyph[row];
        for (uint8_t col = 0; col < FONT_W; col++)
        {
            uint16_t color = (bits & 0x80) ? fg : bg;
            buf[idx++] = (uint8_t)(color >> 8);
            buf[idx++] = (uint8_t)(color & 0xFF);
            bits <<= 1;
        }
    }

    cs_low();
    dc_data();
    HAL_SPI_Transmit(&hspi2, buf, sizeof(buf), 100);
    cs_high();
}

void display_draw_string(uint16_t x, uint16_t y, const char *str,
                          uint16_t fg, uint16_t bg)
{
    while (*str)
    {
        if (x + FONT_W > DISP_W) break;
        display_draw_char(x, y, *str, fg, bg);
        x += FONT_W;
        str++;
    }
}

/* Draw a character at 2x scale (16x32 pixels) */
static void draw_char_2x(uint16_t x, uint16_t y, char c, uint16_t fg, uint16_t bg)
{
    if (c < FONT_FIRST || c > FONT_LAST) c = ' ';
    if (x + FONT_W * 2 > DISP_W || y + FONT_H * 2 > DISP_H) return;

    const uint8_t *glyph = &font_8x16[(c - FONT_FIRST) * FONT_H];

    display_set_window(x, y, x + FONT_W * 2 - 1, y + FONT_H * 2 - 1);

    uint8_t line_buf[FONT_W * 2 * 2]; /* One row = 16 pixels * 2 bytes */

    cs_low();
    dc_data();

    for (uint8_t row = 0; row < FONT_H; row++)
    {
        uint8_t bits = glyph[row];
        uint16_t idx = 0;

        for (uint8_t col = 0; col < FONT_W; col++)
        {
            uint16_t color = (bits & 0x80) ? fg : bg;
            uint8_t hi = (uint8_t)(color >> 8);
            uint8_t lo = (uint8_t)(color & 0xFF);
            /* Each pixel doubled horizontally */
            line_buf[idx++] = hi; line_buf[idx++] = lo;
            line_buf[idx++] = hi; line_buf[idx++] = lo;
            bits <<= 1;
        }

        /* Each row doubled vertically */
        HAL_SPI_Transmit(&hspi2, line_buf, sizeof(line_buf), 50);
        HAL_SPI_Transmit(&hspi2, line_buf, sizeof(line_buf), 50);
    }

    cs_high();
}

void display_draw_string_2x(uint16_t x, uint16_t y, const char *str,
                              uint16_t fg, uint16_t bg)
{
    while (*str)
    {
        if (x + FONT_W * 2 > DISP_W) break;
        draw_char_2x(x, y, *str, fg, bg);
        x += FONT_W * 2;
        str++;
    }
}

/* Measure string width in pixels */
static uint16_t string_width(const char *str)
{
    uint16_t w = 0;
    while (*str++) w += FONT_W;
    return w;
}

void display_draw_centered(uint16_t y, const char *str, uint16_t fg, uint16_t bg)
{
    uint16_t w = string_width(str);
    uint16_t x = (w < DISP_W) ? (DISP_W - w) / 2 : 0;
    display_draw_string(x, y, str, fg, bg);
}

void display_draw_centered_2x(uint16_t y, const char *str, uint16_t fg, uint16_t bg)
{
    uint16_t w = string_width(str) * 2;
    uint16_t x = (w < DISP_W) ? (DISP_W - w) / 2 : 0;
    display_draw_string_2x(x, y, str, fg, bg);
}

/* ========================================================================
 * High-level status display
 * ======================================================================== */

/* Status area layout (landscape 320x240):
 *
 *   [0,0]   ┌──────────────────────────────────────┐
 *           │  Line 0 (status text)                │  y=2
 *           │  Line 1                              │  y=20
 *           │  Line 2                              │  y=38
 *           │  Line 3                              │  y=56
 *           │                                      │
 *           │  [battery icon at top-right]          │
 *           └──────────────────────────────────────┘ [319,239]
 */

void display_set_line(uint8_t line, const char *text)
{
    if (line > 3) return;
    uint16_t y = 2 + line * 18;

    /* Clear line area */
    display_fill_rect(0, y, DISP_W, FONT_H, COLOR_BLACK);

    /* Draw text */
    display_draw_string(4, y, text, COLOR_WHITE, COLOR_BLACK);
}

void display_set_battery(uint8_t soc_pct)
{
    if (soc_pct > 100) soc_pct = 100;

    /* Battery icon at top-right: 30x14 pixels at (286, 2) */
    uint16_t bx = DISP_W - 34;
    uint16_t by = 2;
    uint16_t bw = 28;
    uint16_t bh = 14;

    /* Outline */
    display_draw_rect(bx, by, bw, bh, COLOR_WHITE);
    /* Terminal nub */
    display_fill_rect(bx + bw, by + 3, 3, 8, COLOR_WHITE);

    /* Fill color based on level */
    uint16_t fill_color;
    if (soc_pct > 50)
        fill_color = COLOR_GREEN;
    else if (soc_pct > 20)
        fill_color = COLOR_ORANGE;
    else
        fill_color = COLOR_RED;

    /* Fill level */
    uint16_t fill_w = (uint16_t)((uint32_t)(bw - 4) * soc_pct / 100);
    display_fill_rect(bx + 2, by + 2, fill_w, bh - 4, fill_color);
    /* Clear unfilled portion */
    if (fill_w < bw - 4)
        display_fill_rect(bx + 2 + fill_w, by + 2, bw - 4 - fill_w, bh - 4, COLOR_BLACK);

    /* Percentage text */
    char buf[5];
    snprintf(buf, sizeof(buf), "%3d%%", soc_pct);
    display_draw_string(bx - 34, by, buf, COLOR_WHITE, COLOR_BLACK);
}

void display_set_icon(display_icon_t icon, uint8_t visible)
{
    /* Icons displayed in a row at y=220 (bottom of landscape screen) */
    uint16_t ix = 4;
    uint16_t iy = DISP_H - FONT_H - 2;

    const char *label = "";
    switch (icon)
    {
    case DISPLAY_ICON_CHARGING:  label = "CHG"; ix = 4;   break;
    case DISPLAY_ICON_MOWING:    label = "MOW"; ix = 36;  break;
    case DISPLAY_ICON_ERROR:     label = "ERR"; ix = 68;  break;
    case DISPLAY_ICON_GPS:       label = "GPS"; ix = 100; break;
    case DISPLAY_ICON_LORA:      label = "LRA"; ix = 132; break;
    case DISPLAY_ICON_WIFI:      label = "WFI"; ix = 164; break;
    default: return;
    }

    if (visible)
        display_draw_string(ix, iy, label, COLOR_CYAN, COLOR_BLACK);
    else
        display_fill_rect(ix, iy, 24, FONT_H, COLOR_BLACK);
}

void display_show_version(void)
{
    display_set_line(0, FIRMWARE_VERSION_STRING);
}

void display_show_error(uint16_t error_code)
{
    display_fill(COLOR_RED);

    display_draw_centered_2x(60, "ERROR", COLOR_WHITE, COLOR_RED);

    char buf[16];
    snprintf(buf, sizeof(buf), "Code: %u", error_code);
    display_draw_centered(120, buf, COLOR_WHITE, COLOR_RED);

    display_draw_centered(160, "Check manual", COLOR_WHITE, COLOR_RED);
}

/* ========================================================================
 * Boot animation — "OpenNova" branding
 *
 * Sequence:
 *   1. Dark background fills in
 *   2. "OpenNova" appears letter by letter in teal (#00c4be)
 *   3. Tagline "open-source mower firmware" fades in white
 *   4. Version string appears
 *   5. Brief pause, then clears to normal status display
 * ======================================================================== */

void display_boot_animation(void)
{
    /* Phase 1: Dark background */
    display_fill(COLOR_DARK_BG);
    HAL_Delay(200);

    /* Phase 2: "OpenNova" letter by letter, centered, 2x scale */
    const char *brand = "OpenNova";
    uint16_t brand_w = string_width(brand) * 2;
    uint16_t brand_x = (DISP_W - brand_w) / 2;
    uint16_t brand_y = 70;

    /* Draw decorative line above */
    display_fill_rect(brand_x, brand_y - 12, brand_w, 2, COLOR_CYAN);

    for (uint8_t i = 0; brand[i] != '\0'; i++)
    {
        draw_char_2x(brand_x + i * FONT_W * 2, brand_y, brand[i],
                      COLOR_CYAN, COLOR_DARK_BG);
        HAL_Delay(80);
    }

    /* Draw decorative line below */
    display_fill_rect(brand_x, brand_y + FONT_H * 2 + 8, brand_w, 2, COLOR_CYAN);
    HAL_Delay(150);

    /* Phase 3: Tagline */
    display_draw_centered(brand_y + FONT_H * 2 + 20,
                           "open-source mower firmware",
                           COLOR_GRAY, COLOR_DARK_BG);
    HAL_Delay(300);

    /* Phase 4: Version string */
    display_draw_centered(brand_y + FONT_H * 2 + 44,
                           FIRMWARE_VERSION_STRING,
                           COLOR_DARK_GRAY, COLOR_DARK_BG);
    HAL_Delay(500);

    /* Phase 5: Transition to normal display */
    display_fill(COLOR_BLACK);
}

/* ========================================================================
 * Periodic refresh (no-op — we use direct writes, no framebuffer)
 * ======================================================================== */

void display_refresh(void)
{
    /* Nothing to do — all drawing is immediate via SPI */
}
